## build/Kconfig/Kconfig.shield
```kconfig
osource "/Users/johnacogan/Documents/GitHub/nrf52832_fw/nrf/boards/shields/*/Kconfig.shield"
```

## build/Kconfig/arch/Kconfig
```kconfig
# Load arch Kconfig descriptions.
osource "/Users/johnacogan/Documents/GitHub/nrf52832_fw/zephyr/arch/x86/Kconfig"
osource "/Users/johnacogan/Documents/GitHub/nrf52832_fw/zephyr/arch/xtensa/Kconfig"
osource "/Users/johnacogan/Documents/GitHub/nrf52832_fw/zephyr/arch/sparc/Kconfig"
osource "/Users/johnacogan/Documents/GitHub/nrf52832_fw/zephyr/arch/riscv/Kconfig"
osource "/Users/johnacogan/Documents/GitHub/nrf52832_fw/zephyr/arch/posix/Kconfig"
osource "/Users/johnacogan/Documents/GitHub/nrf52832_fw/zephyr/arch/nios2/Kconfig"
osource "/Users/johnacogan/Documents/GitHub/nrf52832_fw/zephyr/arch/mips/Kconfig"
osource "/Users/johnacogan/Documents/GitHub/nrf52832_fw/zephyr/arch/arm64/Kconfig"
osource "/Users/johnacogan/Documents/GitHub/nrf52832_fw/zephyr/arch/arm/Kconfig"
osource "/Users/johnacogan/Documents/GitHub/nrf52832_fw/zephyr/arch/arc/Kconfig"
```
