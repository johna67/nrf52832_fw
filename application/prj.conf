## CMakeLists.txt
```
cmake_minimum_required(VERSION 3.20.0)
find_package(Zephyr REQUIRED HINTS $ENV{ZEPHYR_BASE})
project(nrf52832_fw)

# 🛠 Pull in MCUmgr
find_package(mcumgr REQUIRED)

target_sources(app PRIVATE src/main.c)
```

## Kconfig
```
rsource "subsys/mgmt/mcumgr/Kconfig"
```

## prj.conf
```kconfig
# Basic system
CONFIG_GPIO=y
CONFIG_LOG=y
CONFIG_LOG_DEFAULT_LEVEL=3

# Enable MCUboot
CONFIG_BOOTLOADER_MCUBOOT=y

# Enable mcumgr and dependencies
CONFIG_MCUMGR=y
CONFIG_MCUMGR_TRANSPORT_BT=y
CONFIG_MCUMGR_SMP_BT=y
CONFIG_MCUMGR_TRANSPORT_UART=n

# Enable ZCBOR and encoding for OTA DFU
CONFIG_ZCBOR=y
CONFIG_MCUMGR_GRP_IMG=y
CONFIG_IMG_MANAGER=y
CONFIG_FLASH=y
CONFIG_STREAM_FLASH=y

# Bluetooth + SMP OTA support
CONFIG_BT=y
CONFIG_BT_PERIPHERAL=y
CONFIG_BT_DEVICE_NAME="nrf52_ota"
CONFIG_BT_SETTINGS=y
CONFIG_SETTINGS=y
CONFIG_NVS=y
CONFIG_BT_GATT_DM=y

# Optional metadata
CONFIG_MCUBOOT_IMAGE_VERSION="0.1.0"
```

## src/main.c
```c
#include <zephyr/kernel.h>
#include <zephyr/sys/printk.h>

void main(void) {
    printk("✅ nRF52832: Zephyr app started.\n");
}
```
